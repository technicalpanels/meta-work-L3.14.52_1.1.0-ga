## imx6ul/conf/layer.conf
```bitbake
# We have a conf and classes directory, add to BBPATH
BBPATH .= ":${LAYERDIR}"

# We have a packages directory, add to BBFILES
BBFILES += "${LAYERDIR}/recipes-*/*/*.bb \
            ${LAYERDIR}/recipes-*/*/*.bbappend"

BBFILE_COLLECTIONS += "chipsee-bsp"
BBFILE_PATTERN_chipsee-bsp := "^${LAYERDIR}/"
BBFILE_PRIORITY_chipsee-bsp = "5"
LAYERVERSION_chipsee-bsp = "1"
```

## meta-chipseeappends/conf/layer.conf
```bitbake
# We have a conf and classes directory, add to BBPATH
BBPATH .= ":${LAYERDIR}"

# We have recipes-* directories, add to BBFILES
BBFILES += "${LAYERDIR}/recipes-*/*/*.bb \
	${LAYERDIR}/recipes-*/*/*.bbappend"

BBFILE_COLLECTIONS += "chipseeappends"
BBFILE_PATTERN_chipseeappends = "^${LAYERDIR}/"
BBFILE_PRIORITY_chipseeappends = "6"
```
